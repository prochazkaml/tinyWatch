#include "chargen.h"
#include "oled.h"
#include <stdint.h>

const uint8_t smallfont[] = {
	0x31, 0x35, 0x53,
	0x13, 0x22, 0x53,
	0x23, 0x13, 0x43,
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	0x02, 0x01, 0x02, 0x01,     // ~
};

const uint8_t bigfont[] = {
	0, 21, 36, 65, 96, 129, 147, 172, 196, 217, 242, // LUT

	/*
	 * Brief explanation of the compression used:
	 * 
	 * Each character is x*20 pixels large, it is stored by column, each one takes up 3 bytes.
	 * The lowest nibble of each column (indicated below with the asterisks) has a special meaning.
	 * If it contains a number other than 0, then the decompression routine will "skip" the next N screen bytes.
	 * If it contains 15, it is treated as the character terminator.
	 * 
	 * Example:
	 * 
	 * // 0             *   1             *   2             *
	 *    0xFF, 0x81, 0x36,                   0x69, 0x42, 0xF0
	 * 
	 * Will get decompressed as:
	 * 
	 * // 0             *   1             *   2             *
	 *    0xFF, 0x81, 0x06, 0x00, 0x00, 0x00, 0x69, 0x42, 0x00
	 */

//  0             *   1             *   2             *   3             *   4             *   5             *   6             *   7             *   8             *   9             *   10            *   11            *   12            *
	0xF8, 0xFF, 0x01, 0xFC, 0xFF, 0x03, 0xFE, 0xFF, 0x67,                                     0x06, 0x00, 0x66,                                     0xFE, 0xFF, 0x07, 0xFC, 0xFF, 0x03, 0xF8, 0xFF, 0xF1, // 0
	0x00, 0x00, 0x60,                                     0x1C, 0x00, 0x00, 0x1E, 0x00, 0x00, 0xE0, 0xFF, 0x37,                   0xFE, 0xFF, 0xF7, // 1
	0x18, 0x00, 0x07, 0x0C, 0x80, 0x01, 0x06, 0xC0, 0x10,       0x60, 0x16,       0x30, 0x00, 0x06, 0x18, 0x10,       0x0C, 0x16,       0x06, 0x00, 0xFE, 0x03, 0x00, 0xFC, 0x01, 0x06, 0xF8, 0x00, 0xF6, // 2
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	0xE0, 0x81, 0x37,                   0xE0, 0x81, 0xF7, // :
};

uint8_t char_len(char c) {
	c -= 32;

	if(c & 1)
		return smallfont[c >> 1] & 0xF;
	else
		return smallfont[c >> 1] >> 4;
}

uint8_t char_draw(char c, uint8_t x, uint8_t y) {
	const uint8_t *addr = smallfont + 48;

	uint8_t w = char_len(c);

	while(c-- > 32) addr += char_len(c);

	for(uint8_t i = 0; i < w; i++) {
		uint8_t b = *addr++;

		for(uint8_t j = 0; j < 8; j++) {
			if(b & 1) oled_set_pixel(x + i, y + j);
			b >>= 1;
		}
	}

	return w;
}

uint8_t char_string_len(const char *c) {
	uint8_t x = -1;

	while(*c != 0) {
		x += char_len(*c++) + 1;
	}

	return x;
}

void char_string_draw(const char *c, uint8_t x, uint8_t y) {
	if(x == STR_CENTER) x = 64 - (char_string_len(c) >> 1);

	while(*c != 0) {
		x += char_draw(*c++, x, y) + 1;
	}
}

void char_draw_large(char c, uint8_t x, uint8_t y) {
	const uint8_t *addr = bigfont + 11 + bigfont[c];
	
	uint8_t bank = 0, b, skip = 0;

	while(skip != 0xF) {
		if(skip) {
			skip--;
		} else {
			b = *addr++;

			if(bank == 16) {
				skip = b >> 4;
				b &= 0x0F;
			}

			for(uint8_t j = 0; j < 8; j++) {
				if(b & 1) {
					for(uint8_t o = 0; o < 3; o++) oled_set_pixel(o + x, y + j + bank);
				}
				
				b >>= 1;
			}
		}

		bank += 8;

		if(bank >= 24) {
			bank = 0;
			x++;
		}
	}
}

